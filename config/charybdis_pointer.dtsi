#include <input/processors.dtsi>
#include <dt-bindings/zmk/input_transform.h>

&trackball_listener {
    /* base processor chain on all layers.
       INV_X/INV_Y выполняются здесь программно (аппаратные инверсии убраны
       из charybdis_right.conf, т.к. сбрасывались при ресете RES_STEP). */
    input-processors = <
        &zip_xy_transform (INPUT_TRANSFORM_X_INVERT | INPUT_TRANSFORM_Y_INVERT)
        &zip_xy_scaler 5 5>;

    /* layer-6 scroll override */
    scroller: scroller {
        layers           = <6>;
        input-processors = <
            &zip_xy_transform (INPUT_TRANSFORM_X_INVERT | INPUT_TRANSFORM_Y_INVERT) // Software invert (RES_STEP не сбрасывается)
            &zip_xy_scaler 1 15                              // Scales the scroll speed
            &zip_xy_to_scroll_mapper                         // Converts XY movement to scroll events
            &zip_scroll_transform (INPUT_TRANSFORM_Y_INVERT) // Inverts the scroll direction
        >;
    };

    /* layer-5 slow-pointer override */
    slow_pointer: slow_pointer {
        layers           = <5>;
        input-processors = <
            &zip_xy_transform (INPUT_TRANSFORM_X_INVERT | INPUT_TRANSFORM_Y_INVERT) // Software invert (RES_STEP не сбрасывается)
            &zip_xy_scaler 2 6>;
    };
};
