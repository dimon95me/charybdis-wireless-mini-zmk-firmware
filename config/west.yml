## config/west.yml
```yaml
manifest:
  remotes:
    - name: zmkfirmware
      url-base: https://github.com/zmkfirmware

    - name: 280Zo
      url-base: https://github.com/280Zo

    - name: urob
      url-base: https://github.com/urob

  projects:
    - name: zmk
      remote: zmkfirmware
      revision: main
      import: app/west.yml

    - name: zmk-pmw3610-driver
      remote: 280Zo
      revision: main

    - name: zmk-unicode
      remote: urob
      revision: main

  self:
    path: config
```
